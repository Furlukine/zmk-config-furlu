## config/boards/shields/furluvoyager/Kconfig.defconfig
```kconfig
if SHIELD_FURLUVOYAGER_LEFT

config ZMK_KEYBOARD_NAME
    default "FurluVoyager"

config ZMK_SPLIT_ROLE_CENTRAL
    default y

endif

if SHIELD_FURLUVOYAGER_LEFT || SHIELD_FURLUVOYAGER_RIGHT

config ZMK_SPLIT
    default y

endif
```

## config/boards/shields/furluvoyager/Kconfig.shield
```kconfig
config SHIELD_FURLUVOYAGER_LEFT
    def_bool $(shields_list_contains,FurluVoyager_left)

config SHIELD_FURLUVOYAGER_RIGHT
    def_bool $(shields_list_contains,FurluVoyager_right)
```
